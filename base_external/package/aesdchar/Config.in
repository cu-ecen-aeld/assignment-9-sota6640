## base_external/package/aesdchar/Config.in
```kconfig
config BR2_PACKAGE_AESDCHAR
	bool "aesdchar"
	help
	  Supports building and installing aesd character driver into root fs.
	  Used to understand buildroot external trees and package builds.
```

## base_external/package/ldd/Config.in
```kconfig
config BR2_PACKAGE_LDD
	bool "ldd"
	help
	  Supports building and installing misc-modules and scull components into root fs.
	  Used to understand buildroot external trees and package builds.
```
